MEMORY
{
    PM_PLUGIN_TEXT (rx) : ORIGIN = @PM_PLUGIN_TEXT_ORIGIN@, LENGTH = @PM_PLUGIN_TEXT_LENGTH@
    PM_PLUGIN_RODATA (r) : ORIGIN = @PM_PLUGIN_RODATA_ORIGIN@, LENGTH = @PM_PLUGIN_RODATA_LENGTH@
    PM_PLUGIN_DATA (rw) : ORIGIN = @PM_PLUGIN_DATA_ORIGIN@, LENGTH = @PM_PLUGIN_DATA_LENGTH@
}
INCLUDE "@PM_PLUGIN_LINKER_SCRIPT@"
ENTRY(pm_plugin_get_descriptor)
