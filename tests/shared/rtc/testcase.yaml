## tests/shared/rtc/testcase.yaml
```yaml
common:
  tags: [shared, rtc]
  harness: ztest
tests:
  ef800.shared.rtc:
    platform_allow:
      - native_sim
```

## tests/shared/ui/testcase.yaml
```yaml
tests:
  shared.ui:
    tags:
      - ef800
      - ui
    harness: ztest
    platform_allow:
      - native_sim
```

## tests/shared/virtual_display/testcase.yaml
```yaml
tests:
  shared.virtual_display:
    tags:
      - ef800
      - virtual
      - display
    harness: ztest
    platform_allow:
      - native_sim
```

## tests/shared/virtual_keyboard/testcase.yaml
```yaml
tests:
  shared.virtual_keyboard:
    tags:
      - ef800
      - virtual
      - keyboard
    harness: ztest
    platform_allow:
      - native_sim
```

## tests/shared/virtual_log/testcase.yaml
```yaml
tests:
  shared.virtual_log:
    tags:
      - ef800
      - virtual
      - logging
    harness: ztest
    platform_allow:
      - native_sim
```

## tests/shared/virtual_plugin/testcase.yaml
```yaml
tests:
  shared.virtual_plugin:
    tags:
      - ef800
      - virtual
      - plugin
    harness: ztest
    platform_allow:
      - native_sim
```

## tests/shared/virtual_profile/testcase.yaml
```yaml
tests:
  shared.virtual_profile:
    tags:
      - ef800
      - virtual
    harness: ztest
    platform_allow:
      - native_sim
```

## tests/shared/virtual_protocol/testcase.yaml
```yaml
tests:
  shared.virtual_protocol:
    tags:
      - ef800
      - virtual
      - protocol
    harness: ztest
    platform_allow:
      - native_sim
```

## tests/shared/virtual_serial/testcase.yaml
```yaml
tests:
  shared.virtual_serial:
    tags:
      - ef800
      - virtual
      - serial
    harness: ztest
    platform_allow:
      - native_sim
```

## tests/shared/virtual_startup/testcase.yaml
```yaml
tests:
  shared.virtual_startup:
    tags:
      - ef800
      - virtual
    harness: ztest
    platform_allow:
      - native_sim
```

## tests/shared/virtual_storage/testcase.yaml
```yaml
tests:
  shared.virtual_storage:
    tags:
      - ef800
      - virtual
      - storage
    harness: ztest
    platform_allow:
      - native_sim
```

## tests/shared/virtual_supervisor/testcase.yaml
```yaml
tests:
  shared.virtual_supervisor:
    tags:
      - ef800
      - virtual
      - plugin
    harness: ztest
    platform_allow:
      - native_sim
```

## tests/shared/virtual_usb/testcase.yaml
```yaml
common:
  tags: [shared, virtual, usb, mtp]
  harness: ztest
tests:
  ef800.shared.virtual_usb:
    platform_allow:
      - native_sim
```

## tests/shared/workspace_editor/testcase.yaml
```yaml
tests:
  ef800.shared.workspace_editor:
    tags: [ef800, workspace, editor]
    harness: ztest
    platform_allow:
      - native_sim
```
