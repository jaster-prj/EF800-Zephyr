## boards/ef800/Kconfig.defconfig
```kconfig
# SPDX-License-Identifier: Apache-2.0

if BOARD_EF800

config BOARD
	default "ef800"

endif
```

## boards/ef800/Kconfig.ef800
```kconfig
# SPDX-License-Identifier: Apache-2.0

config BOARD_EF800
	select SOC_STM32L496XX
```

## boards/ef800/board.yml
```yaml
board:
  name: ef800
  full_name: EF800 main controller
  vendor: jaster
  socs:
    - name: stm32l496xx
```

## boards/ef800_keyboard/Kconfig.defconfig
```kconfig
# SPDX-License-Identifier: Apache-2.0

if BOARD_EF800_KEYBOARD

config BOARD
	default "ef800_keyboard"

endif
```

## boards/ef800_keyboard/Kconfig.ef800_keyboard
```kconfig
# SPDX-License-Identifier: Apache-2.0

config BOARD_EF800_KEYBOARD
	select SOC_STM32L431XX
```

## boards/ef800_keyboard/board.yml
```yaml
board:
  name: ef800_keyboard
  full_name: EF800 keyboard controller
  vendor: jaster
  socs:
    - name: stm32l431xx
```

## boards/ef800_keyboard/dts/bindings/input/jaster,ef800-keyboard.yaml
```yaml
# SPDX-License-Identifier: Apache-2.0

description: EF800 matrix keyboard controller GPIO assignment

compatible: "jaster,ef800-keyboard"

include: base.yaml

properties:
  row-gpios:
    type: phandle-array
    required: true
  column-gpios:
    type: phandle-array
    required: true
  special-gpios:
    type: phandle-array
    required: true
```

## dts/bindings/misc/jaster,ef800-lcd-contrast.yaml
```yaml
# SPDX-License-Identifier: Apache-2.0

description: EF800 runtime LCD contrast PWM pin configuration

compatible: "jaster,ef800-lcd-contrast"

include: [base.yaml, pinctrl-device.yaml]

properties:
  gpios:
    type: phandle-array
    required: true

  pinctrl-0:
    required: true

  pinctrl-names:
    required: true
```

## manifest-repo/west.yml
```yaml
manifest:
  defaults:
    remote: upstream

  remotes:
    - name: upstream
      url-base: https://github.com/zephyrproject-rtos
    - name: jaster-prj
      url-base: https://github.com/jaster-prj

  projects:
    - name: zephyr
      remote: upstream
      revision: v4.5.0
      west-commands: scripts/west-commands.yml
      import: true
    - name: PluginManager
      remote: jaster-prj
      revision: 07ad72b508f22e5ecf4787bb7f21ca30418119e1
      path: modules/lib/PluginManager
    - name: zephyr-mtp
      remote: jaster-prj
      revision: cb1cad67b79771f8b9e56d66170e8c02c3f3e5b7
      path: modules/lib/ZephyrMTP

  self:
    path: application/manifest-repo
```

## tests/shared/backup_mtp/testcase.yaml
```yaml
common:
  tags: [shared, backup, mtp]
  harness: ztest
tests:
  ef800.shared.backup_mtp:
    platform_allow:
      - native_sim
```

## tests/shared/backup_update/testcase.yaml
```yaml
tests:
  ef800.shared.backup_update:
    tags:
      - ef800
      - update
      - flash
    platform_allow:
      - native_sim
    integration_platforms:
      - native_sim
```

## tests/shared/battery_soc/testcase.yaml
```yaml
tests:
  ef800.shared.battery_soc:
    tags:
      - ef800
      - battery
      - soc
    harness: ztest
    platform_allow:
      - native_sim
```

## tests/shared/boot_update/testcase.yaml
```yaml
common:
  tags: [shared, bootloader, update]
  harness: ztest
tests:
  ef800.shared.boot_update:
    platform_allow:
      - native_sim
```

## tests/shared/composition/testcase.yaml
```yaml
common:
  tags: [shared, composition, persistence]
  harness: ztest
tests:
  ef800.shared.composition:
    platform_allow:
      - native_sim
```

## tests/shared/core/testcase.yaml
```yaml
common:
  tags:
    - shared
    - ef800
  harness: ztest
tests:
  ef800.shared.core:
    platform_allow:
      - native_sim
```

## tests/shared/firmware_package/testcase.yaml
```yaml
tests:
  ef800.shared.firmware_package:
    platform_allow:
      - native_sim
    tags:
      - ef800
      - update
      - package
```

## tests/shared/keyboard/testcase.yaml
```yaml
common:
  tags: [shared, keyboard]
  harness: ztest
tests:
  ef800.shared.keyboard:
    platform_allow:
      - native_sim
```

## tests/shared/keyboard_update/testcase.yaml
```yaml
common:
  tags: [shared, keyboard, update]
  harness: ztest
tests:
  ef800.shared.keyboard_update:
    platform_allow:
      - native_sim
```

## tests/shared/lcd_contrast/testcase.yaml
```yaml
common:
  tags: [shared, lcd-contrast]
  harness: ztest
tests:
  ef800.shared.lcd_contrast:
    platform_allow:
      - native_sim
```

## tests/shared/measurement/testcase.yaml
```yaml
common:
  tags: [shared, measurement]
  harness: ztest
tests:
  ef800.shared.measurement:
    platform_allow:
      - native_sim
```

## tests/shared/metadata/testcase.yaml
```yaml
common:
  tags: [shared, metadata]
  harness: ztest
tests:
  ef800.shared.metadata:
    platform_allow:
      - native_sim
```

## tests/shared/persistence/testcase.yaml
```yaml
common:
  tags: [shared, persistence]
  harness: ztest
tests:
  ef800.shared.persistence:
    platform_allow:
      - native_sim
```

## tests/shared/plugin/testcase.yaml
```yaml
common:
  tags: [shared, plugin]
  harness: ztest
tests:
  ef800.shared.plugin:
    platform_allow:
      - native_sim
```

## tests/shared/ports/testcase.yaml
```yaml
common:
  tags: [shared, ports]
  harness: ztest
tests:
  ef800.shared.ports:
    platform_allow:
      - native_sim
```
